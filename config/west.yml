## config/west.yml
```yaml
manifest:
  remotes:
    - name: ky1ejs
      url-base: https://github.com/ky1ejs
  projects:
    - name: zmk
      remote: ky1ejs
      revision: tornblue_update_zmk_version
      import: app/west.yml
  self:
    path: config
```
